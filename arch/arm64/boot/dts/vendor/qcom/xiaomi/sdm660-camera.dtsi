&soc {
	qcom,csiphy@c824000 {
		qcom,clock-rates = <0 0 0 0 0 0 310000000 0 0 269333333 0
			0 269000000 0 0>;
	};

	qcom,csiphy@c826000 {
		qcom,clock-rates = <0 0 0 0 0 0 310000000 0 0 269333333 0
			0 269000000 0 0>;
	};
};
