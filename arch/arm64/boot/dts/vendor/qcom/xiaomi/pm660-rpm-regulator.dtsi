&rpm_bus {
	rpm-regulator-ldoa16 {
		status = "okay";

		regulator-l16 {
			regulator-min-microvolt = <2800000>;
			regulator-max-microvolt = <2800000>;
			status = "okay";
			regulator-always-on;
		};
	};
};
